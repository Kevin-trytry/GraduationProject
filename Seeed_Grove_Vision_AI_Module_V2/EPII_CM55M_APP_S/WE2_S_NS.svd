# WE2_S_NS register map
Vendor: ARM Ltd.; Series: ARMv8.1-M Mainline; File version: 1.0
ARM 32-bit Cortex-M55 based device
CPU: CM55 r1p1, little endian, MPU, FPU, double-precision FPU, DSP, VTOR, 3 interrupt priority bits
Registers are 32-bit, read-write, reset 0x0 unless marked. A register's access mark holds for its fields unless they carry their own. Offsets are from the block's base; lines under a group give offsets from that group; [hi:lo] are bit positions; {n}, {i} and the like mark numbered series; 'fields as' and 'values as' point back to an identical list; <NAME> marks a mode.

## Memory map
0x2A000000 QSPI_M_NS size 0x1000
0x2C000000 OSPI_M_NS size 0x1000
0x3A000000 QSPI_M size 0x1000 — QSPI_M (spi 0)
0x3C000000 OSPI_M size 0x1000 — OSPI_M (spi 2)
0x40000000 DMA0_NS size 0x1000
0x40800000 SSPI_M_NS size 0x1000
0x40810000 SSPI_S_NS size 0x1000
0x41000000 DMA1_NS size 0x1000
0x41800000 DMA2_NS size 0x1000
0x41810000 DMA3_NS size 0x1000
0x42000000 UART1_NS size 0x100
0x42001000 SCU_LSC_NS size 0x1000
0x42002000 I3C_SLV_1_NS size 0x1000
0x42003000 PWM0_NS size 0x24
0x42003040 PWM1_NS size 0x24
0x42003080 PWM2_NS size 0x24
0x42004000 I2C_MST_1_NS size 0x100
0x42009F00 VAD_NS size 0x50
0x4200C000 ADC_LV_NS size 0x100
0x4200C800 ADCC_LV_NS size 0x100
0x4200E000 SENCTRL_LSC_NS size 0x100
0x4200EB00 INPOV_LSC_NS size 0x100
0x4200ED00 INP1BIT_LSC_NS size 0x100
0x43010000 mpc_ospi_NS size 0x100
0x43060000 CSITX_NS size 0x1000
0x43070000 SCU_HSC_NS size 0x1000
0x430C0000 mpc_sram0_NS size 0x100
0x430D0000 mpc_sram1_NS size 0x100
0x430E0000 mpc_qspicache_NS size 0x100
0x430F0000 I3C_MST_NS size 0x200
0x430F8000 CSIRX_NS size 0x1000
0x43100100 INP_HSC_NS size 0x100
0x43100300 DP_HSC_NS size 0x10
0x43100800 JPEG_HSC_NS size 0x100
0x44000000 I2C_SLV_0_NS size 0x100
0x44001000 I2C_MST_0_NS size 0x100
0x44002000 I2S_HOST_NS size 0x400
0x44003000 UART0_NS size 0x100
0x44004000 UART2_NS size 0x100
0x44005000 PDM1_NS size 0x400
0x44006000 GPIO0_NS size 0x600
0x44007000 GPIO1_NS size 0x600
0x44008000 GPIO2_NS size 0x600
0x44009000 GPIO3_NS size 0x600
0x4400A000 MB_NS size 0x300
0x4400B000 I2S_SLAVE_NS size 0x400
0x4400C000 mpc_sram2_NS size 0x100
0x4400D000 I3C_SLV_0_NS size 0x1000
0x4400E000 I2C_SLV_1_NS size 0x100
0x4400F000 PDM0_NS size 0x400
0x45000000 WDT0_NS size 0x1000
0x45001000 WDT1_NS size 0x1000
0x45004100 INP_NS size 0x100
0x45004200 CDM_NS size 0x100
0x45004300 DP_NS size 0x10
0x45004600 TPG_NS size 0x40
0x45004700 XDMA_NS size 0x100
0x45004800 JPEG_NS size 0x100
0x45004900 DP_CSC_NS size 0x4
0x45004A00 DP_RGB2YUV_NS size 0x4
0x45004C00 EDM_NS size 0x100
0x45005000 SENCTRL_NS size 0x100
0x45005B00 INPOV_NS size 0x100
0x45005D00 INP1BIT_NS size 0x100
0x45006000 CSIRX_DPHY_NS size 0x1000
0x4500A000 TIMER0_NS size 0x30
0x4500B000 TIMER1_NS size 0x30
0x4500C000 TIMER2_NS size 0x30
0x4500D000 TIMER3_NS size 0x30
0x4500E000 TIMER4_NS size 0x30
0x4500F000 TIMER5_NS size 0x30
0x46002000 GPIO4_NS size 0x600
0x46005000 ADC_HV_NS size 0x100
0x46005800 ADCC_HV_NS size 0x100
0x46006000 SCU_SB_NS size 0x1000
0x46008000 AUTOI2C_MST_NS size 0x100
0x46009000 TIMER6_NS size 0x30
0x4600A000 TIMER7_NS size 0x30
0x4600B000 TIMER8_NS size 0x30
0x46100000 SCU_AON_NS size 0x1000
0x46101000 PMU_NS size 0x100
0x46103000 GPIO5_NS size 0x600
0x46107000 RTC0_NS size 0x20
0x46108000 RTC1_NS size 0x20
0x46109000 RTC2_NS size 0x20
0x4610F000 SWREG_AON_NS size 0x20
0x50000000 DMA0 size 0x1000
0x50800000 SSPI_M size 0x1000 — SSPI_M (spi 1)
0x50810000 SSPI_S size 0x1000 — SSPI_S (spi 0)
0x51000000 DMA1 size 0x1000
0x51010000 ISP size 0x100
0x51800000 DMA2 size 0x1000
0x51810000 DMA3 size 0x1000
0x52000000 UART1 size 0x100
0x52001000 SCU_LSC size 0x1000
0x52002000 I3C_SLV_1 size 0x1000
0x52003000 PWM0 size 0x24
0x52003040 PWM1 size 0x24
0x52003080 PWM2 size 0x24
0x52004000 I2C_MST_1 size 0x100
0x52009F00 VAD size 0x50
0x5200C000 ADC_LV size 0x100
0x5200C800 ADCC_LV size 0x100
0x5200E000 SENCTRL_LSC size 0x100
0x5200EB00 INPOV_LSC size 0x100
0x5200ED00 INP1BIT_LSC size 0x100
0x53010000 mpc_ospi size 0x100 — mpc_ospi flash2
0x53060000 CSITX size 0x1000 — MIPI_TX_CTRL
0x53070000 SCU_HSC size 0x1000
0x530C0000 mpc_sram0 size 0x100
0x530D0000 mpc_sram1 size 0x100
0x530E0000 mpc_qspicache size 0x100 — mpc_qspicache flash1
0x530F0000 I3C_MST size 0x200
0x530F8000 CSIRX size 0x1000 — MIPI_RX_CTRL
0x53100100 INP_HSC size 0x100
0x53100300 DP_HSC size 0x10
0x53100800 JPEG_HSC size 0x100
0x54000000 I2C_SLV_0 size 0x100
0x54001000 I2C_MST_0 size 0x100
0x54002000 I2S_HOST size 0x400
0x54003000 UART0 size 0x100
0x54004000 UART2 size 0x100
0x54005000 PDM1 size 0x400 — SYNOPSYS PDM
0x54006000 GPIO0 size 0x600
0x54007000 GPIO1 size 0x600
0x54008000 GPIO2 size 0x600
0x54009000 GPIO3 size 0x600
0x5400A000 MB size 0x300
0x5400B000 I2S_SLAVE size 0x400
0x5400C000 mpc_sram2 size 0x100
0x5400D000 I3C_SLV_0 size 0x1000
0x5400E000 I2C_SLV_1 size 0x100
0x5400F000 PDM0 size 0x400 — HIMAX PDM
0x55000000 WDT0 size 0x1000
0x55001000 WDT1 size 0x1000
0x55004100 INP size 0x100
0x55004200 CDM size 0x100
0x55004300 DP size 0x10
0x55004600 TPG size 0x40
0x55004700 XDMA size 0x100
0x55004800 JPEG size 0x100
0x55004900 DP_CSC size 0x4
0x55004A00 DP_RGB2YUV size 0x4
0x55004C00 EDM size 0x100
0x55005000 SENCTRL size 0x100
0x55005B00 INPOV size 0x100
0x55005D00 INP1BIT size 0x100
0x55006000 CSIRX_DPHY size 0x1000 — dphy lane control
0x5500A000 TIMER0 size 0x30
0x5500B000 TIMER1 size 0x30
0x5500C000 TIMER2 size 0x30
0x5500D000 TIMER3 size 0x30
0x5500E000 TIMER4 size 0x30
0x5500F000 TIMER5 size 0x30
0x56002000 GPIO4 size 0x600
0x56005000 ADC_HV size 0x100
0x56005800 ADCC_HV size 0x100
0x56006000 SCU_SB size 0x1000
0x56008000 AUTOI2C_MST size 0x100
0x56009000 TIMER6 size 0x30
0x5600A000 TIMER7 size 0x30
0x5600B000 TIMER8 size 0x30
0x56100000 SCU_AON size 0x1000
0x56101000 PMU size 0x100
0x56103000 GPIO5 size 0x600
0x56107000 RTC0 size 0x20
0x56108000 RTC1 size 0x20
0x56109000 RTC2 size 0x20
0x5610F000 SWREG_AON size 0x20
0xE0000000 SYS_ITM size 0x1000
0xE0001000 SYS_DWT size 0x20 — Data Watchpoint and Trace (DWT) registers
0xE0002000 SYS_BPU size 0x28 — Direct Cache Access Registers
0xE0003000 SYS_PMU size 0x1000 — Performance Monitoring Unit
0xE000E000 SYS_ICB size 0x20 — Implementation control block register
0xE000E100 SYS_NVIC size 0x500 — Nested Vectored Interrupt Controller
0xE000ED00 SYS_SCB size 0x90 — System control block
0xE000ED90 SYS_MPU size 0x38 — Memory Protection Unit (MPU) register
0xE000EDD0 SYS_SAU size 0x1C — Security Attribution Unit (SAU) register
0xE000EDF0 SYS_DCB size 0x1C
0xE000EF00 SYS_NVIC_STIR size 0x4 — Software Interrupt Generation register
0xE000EF30 SYS_FPU size 0x1C — Floating-Point Context Control Register
0xE000EF50 SYS_CM size 0x2C — Cache maintenance operations
0xE000EFB0 SYS_DIB size 0x1C — Debug Identification Block Registers
0xE001E000 SYS_IMPL_DEF size 0x1000
0xE002E000 SYS_ICB_NS size 0x20
0xE002E100 SYS_NVIC_NS size 0x500
0xE002ED00 SYS_SCB_NS size 0x90
0xE002ED90 SYS_MPU_NS size 0x38
0xE002EDF0 SYS_DCB_NS size 0x1C
0xE002EF00 SYS_NVIC_STIR_NS size 0x4
0xE002EF30 SYS_FPU_NS size 0x1C
0xE002EF50 SYS_CM_NS size 0x2C
0xE002EFB0 SYS_DIB_NS size 0x1C
0xE00FF000 ROMTable size 0x1000 — Processor ROM table components

## Interrupts
7 MBOX (MB) — MBOX_IRQn
16 RTC0INTR (RTC0) — RTC0INTR_IRQn
17 RTC1INTR (RTC1) — RTC1INTR_IRQn
18 RTC2INTR (RTC2) — RTC2INTR_IRQn
19 GPIO_GROUP_5_AON (GPIO5) — GPIO_GROUP_5_AON_IRQn
22 pmu_wdg_timeout_int (PMU) — pmu_wdg_timeout_int_IRQn
23 anti_tamp_int (SCU_AON) — anti_tamp_int_IRQn
34 TIMER0INT (TIMER0) — TIMER0INT_IRQn
35 TIMER1INT (TIMER1) — TIMER1INT_IRQn
36 TIMER2INT (TIMER2) — TIMER2INT_IRQn
37 TIMER3INT (TIMER3) — TIMER3INT_IRQn
38 TIMER4INT (TIMER4) — TIMER4INT_IRQn
39 TIMER5INT (TIMER5) — TIMER5INT_IRQn
42 GPIO_GROUP_4_SB (GPIO4) — GPIO_GROUP_4_SB_IRQn
44 ADC_CTRL_HV (ADC_HV) — ADC_CTRL_HV_IRQn
47 TIMER6INT (TIMER6) — TIMER6INT_IRQn
48 TIMER7INT (TIMER7) — TIMER7INT_IRQn
49 TIMER8INT (TIMER8) — TIMER8INT_IRQn
50 mipi_i2c_mst_noack_int (AUTOI2C_MST) — mipi_i2c_mst_noack_int_IRQn
70 adcc_lv_int_out (ADCC_LV) — adcc_lv_int_out_IRQn
80 PDM_int_rx_avail (PDM1) — PDM_int_rx_avail_IRQn
81 PDM_int_err (PDM1) — PDM_int_err_IRQn
82 PDM_int_clp (PDM1) — PDM_int_clp_IRQn
83 inpparser_error_int_out (INP1BIT) — inpparser_error_int_out_IRQn
87 pwm0_int_out (PWM0) — pwm0_int_out_IRQn
88 pwm1_int_out (PWM1) — pwm1_int_out_IRQn
89 pwm2_int_out (PWM2) — pwm2_int_out_IRQn
90 UART0_intr (UART0) — UART0_intr_IRQn
91 UART1_intr (UART1) — UART1_intr_IRQn
92 I2C_SLAVE_intr (I2C_SLV_0) — I2C_SLAVE_intr_IRQn
93 I2C_MST_0_intr (I2C_MST_0) — I2C_MST_0_intr_IRQn
94 I3C_SLAVE_intr (I3C_SLV_0) — I3C_SLAVE_intr_IRQn
95 UART2_intr (UART2) — UART2_intr_IRQn
96 I2C_MST_1_intr (I2C_MST_1) — I2C_MST_1_intr_IRQn
97 AHB_SRAM2_MPC (mpc_sram2) — AHB_SRAM2_MPC_IRQn
105 SSPI_HOST (SSPI_M) — SSPI_HOST_IRQn
106 SSPI_SLAVE (SSPI_S) — SSPI_SLAVE_IRQn
107 GPIO_GROUP_0 (GPIO0) — GPIO_GROUP_0_IRQn
108 GPIO_GROUP_1 (GPIO1) — GPIO_GROUP_1_IRQn
109 GPIO_GROUP_2 (GPIO2) — GPIO_GROUP_2_IRQn
110 GPIO_GROUP_3 (GPIO3) — GPIO_GROUP_3_IRQn
111 VAD_D (VAD) — VAD_D_IRQn
112 I2C_Slave_1 (I2C_SLV_1) — I2C_Slave_1_IRQn
113 I3C_Slave_1 (I3C_SLV_1) — I3C_Slave_1_IRQn
114 HimaxPDM_int_rx_avail (PDM0) — HimaxPDM_int_rx_avail_IRQn
115 HimaxPDM_int_err (PDM0) — HimaxPDM_int_err_IRQn
116 HimaxPDM_int_clp (PDM0) — HimaxPDM_int_clp_IRQn
136 inp_vsync_in (INP) — inp_vsync_in_IRQn
137 inp_hsync_in (INP) — inp_hsync_in_IRQn
138 inp_vsync_out (INP) — inp_vsync_out_IRQn
139 inp_hsync_out (INP) — inp_hsync_out_IRQn
140 REG_INP_S2P_ERROR_INT (INP) — REG_INP_S2P_ERROR_INT_IRQn
150 INP_RX_DE_HCNT_ERROR_INT (INP) — INP_RX_DE_HCNT_ERROR_INT_IRQn
151 INP_RX2OUT_DE_HCNT_ERROR_INT (INP) — INP_RX2OUT_DE_HCNT_ERROR_INT_IRQn
152 WDMA1_int (XDMA) — WDMA1_int_IRQn
153 WDMA1_abnormal_int (XDMA) — WDMA1_abnormal_int_IRQn
154 WDMA2_int (XDMA) — WDMA2_int_IRQn
155 WDMA2_abnormal_int (XDMA) — WDMA2_abnormal_int_IRQn
156 WDMA3_int (XDMA) — WDMA3_int_IRQn
157 WDMA3_abnormal_int (XDMA) — WDMA3_abnormal_int_IRQn
158 RDMA_int (XDMA) — RDMA_int_IRQn
159 RDMA_abnormal_int (XDMA) — RDMA_abnormal_int_IRQn
160 I3C_INT (I3C_MST) — I3C_INT_IRQn
163 OSPI_MPC (mpc_ospi) — OSPI_MPC_IRQn
164 QSPI_ssi_intp (QSPI_M) — QSPI_ssi_intp_IRQn
165 OSPI (OSPI_M) — OSPI_IRQn
169 AXI_SRAM0_AXI_MPC (mpc_sram0) — AXI_SRAM0_AXI_MPC_IRQn
170 AXI_SRAM1_AXI_MPC (mpc_sram1) — AXI_SRAM1_AXI_MPC_IRQn
173 qspi_cache_Cache_MPC (mpc_qspicache) — qspi_cache_Cache_MPC_IRQn
180 MIPI_RX_Interrupt0 (CSIRX) — MIPI_RX_Interrupt0_IRQn
181 MIPI_RX_Interrupt1 (CSIRX) — MIPI_RX_Interrupt1_IRQn
182 MIPI_RX_Interrupt2 (CSIRX) — MIPI_RX_Interrupt2_IRQn
183 MIPI_RX_Interrupt3 (CSIRX) — MIPI_RX_Interrupt3_IRQn
184 MIPI_TX (CSITX) — MIPI_TX_IRQn

## Licence text in the file
ARM Limited (ARM) is supplying this software for use with Cortex-M processor based microcontroller, but can be equally used for other suitable processor architectures. This file can be freely distributed. Modifications to this file shall be clearly marked. . THIS SOFTWARE IS PROVIDED "AS IS". NO WARRANTIES, WHETHER EXPRESS, IMPLIED. OR STATUTORY, INCLUDING, BUT NOT LIMITED TO, IMPLIED WARRANTIES OF. MERCHANTABILITY AND FITNESS FOR A PARTICULAR PURPOSE APPLY TO THIS SOFTWARE. ARM SHALL NOT, IN ANY CIRCUMSTANCES, BE LIABLE FOR SPECIAL, INCIDENTAL, OR. CONSEQUENTIAL DAMAGES, FOR ANY REASON WHATSOEVER.

## Notices in the file
Copyright (C) 2012 - 2020 Arm Limited. All rights reserved.
Purpose: System Viewer Description (SVD) Example (Schema Version 1.1)
This is a description of a none-existent and incomplete device
for demonstration purposes only.
Redistribution and use in source and binary forms, with or without
modification, are permitted provided that the following conditions are met:
- Redistributions of source code must retain the above copyright
notice, this list of conditions and the following disclaimer.
- Redistributions in binary form must reproduce the above copyright
notice, this list of conditions and the following disclaimer in the
documentation and/or other materials provided with the distribution.
- Neither the name of ARM nor the names of its contributors may be used
to endorse or promote products derived from this software without
specific prior written permission.
THIS SOFTWARE IS PROVIDED BY THE COPYRIGHT HOLDERS AND CONTRIBUTORS "AS IS"
AND ANY EXPRESS OR IMPLIED WARRANTIES, INCLUDING, BUT NOT LIMITED TO, THE
ARE DISCLAIMED. IN NO EVENT SHALL COPYRIGHT HOLDERS AND CONTRIBUTORS BE
LIABLE FOR ANY DIRECT, INDIRECT, INCIDENTAL, SPECIAL, EXEMPLARY, OR
CONSEQUENTIAL DAMAGES (INCLUDING, BUT NOT LIMITED TO, PROCUREMENT OF
SUBSTITUTE GOODS OR SERVICES; LOSS OF USE, DATA, OR PROFITS; OR BUSINESS
INTERRUPTION) HOWEVER CAUSED AND ON ANY THEORY OF LIABILITY, WHETHER IN
CONTRACT, STRICT LIABILITY, OR TORT (INCLUDING NEGLIGENCE OR OTHERWISE)
ARISING IN ANY WAY OUT OF THE USE OF THIS SOFTWARE, EVEN IF ADVISED OF THE
POSSIBILITY OF SUCH DAMAGE.
