# WE2_S_NS register map
Vendor: ARM Ltd.; Series: ARMv8.1-M Mainline; File version: 1.0
CPU: CM55 r1p1, little endian, MPU, FPU, double-precision FPU, DSP, VTOR, 3 interrupt priority bits
Registers are 32-bit, read-write, reset 0x0 unless marked. A register's access mark holds for its fields unless they carry their own. Offsets are from the block's base; [hi:lo] are bit positions; {n}, {i} and the like mark numbered series.

## SYS_DIB — Debug Identification Block Registers
Base 0xE000EFB0
Same registers: SYS_DIB_NS 0xE002EFB0
0x00 DLAR wo — SCS Software Lock Access Register
0x04 DLSR ro — SCS Software Lock Status Register
0x08 DAUTHSTATUS ro — Debug Authentication Status Register
0x0C DDEVARCH ro — SCS Device Architecture Register
0x10 DDEVTYPE ro — SCS Device Type Register

## ROMTable — Processor ROM table components
Base 0xE00FF000
0x00 SCS ro
0x04 DWT ro
0x08 BPU ro
0x0C ITM ro
0x10 TPIU ro
0x14 ETM ro
0x18 PMU ro
0x1C CTI ro
0x20 PMC100 ro
0xFD0 PIDR4 ro reset 0x4
{0xFC0+4i} PIDR{i} ro (i=5..7)
0xFE0 PIDR0 ro reset 0xD2
0xFE4 PIDR1 ro reset 0xB4
0xFE8 PIDR2 ro reset 0xB
0xFEC PIDR3 ro
0xFF0 CIDR0 ro reset 0xD
0xFF4 CIDR1 ro reset 0x10
0xFF8 CIDR2 ro reset 0x5
0xFFC CIDR3 ro reset 0xB1

## I2C_MST_0
Base 0x54001000
Same registers: I2C_MST_1_NS 0x42004000, I2C_SLV_0_NS 0x44000000, I2C_MST_0_NS 0x44001000, I2C_SLV_1_NS 0x4400E000, I2C_MST_1 0x52004000, I2C_SLV_0 0x54000000, I2C_SLV_1 0x5400E000
0x00 IC_CON — IIC control
0x04 IC_TAR — IIC target address
0x08 IC_SAR — IIC slave address
0x0C IC_HS_MADDR — IIC HS Master Mode Code address
0x10 IC_DATA_CMD — IIC Rx/Tx Data Buffer and Command
0x14 IC_SS_SCL_HCNT — Standard Speed IIC clock SCL High Count
0x18 IC_SS_SCL_LCNT — Standard Speed IIC clock SCL Low Count
0x1C IC_FS_SCL_HCNT — Fast Speed IIC clock SCL High Count
0x20 IC_FS_SCL_LCNT — Fast Speed IIC clock SCL Low Count
0x24 IC_HS_SCL_HCNT — High Speed IIC clock SCL High Count
0x28 IC_HS_SCL_LCNT — High Speed IIC clock SCL Low Count
0x2C IC_INTR_STAT — IIC Interrupt Status
0x30 IC_INTR_MASK — IIC Interrupt Mask
0x34 IC_RAW_INTR_STAT — IIC Raw Interrupt Status
0x38 IC_RX_TL — IIC Receive FIFO Threshold
0x3C IC_TX_TL — IIC Transmit FIFO Threshold
0x40 IC_CLR_INTR — Clear combined and Individual Interrupts
0x44 IC_CLR_RX_UNDER — Clear RX_UNDER Interrupt
0x48 IC_CLR_RX_OVER — Clear RX_OVER Interrupt
0x4C IC_CLR_TX_OVER — Clear TX_OVER Interrupt
0x50 IC_CLR_RD_REQ — Clear RQ_REQ Interrupt
0x54 IC_CLR_TX_ABRT — Clear TX_ABRT Interrupt
0x58 IC_CLR_RX_DONE — Clear RX_DONE Interrupt
0x5C IC_CLR_ACTIVITY — Clear ACTIVITY Interrupt
0x60 IC_CLR_STOP_DET — Clear STOP_DET Interrupt
0x64 IC_CLR_START_DET — Clear START_DET Interrupt
0x68 IC_CLR_GEN_CALL — Clear GEN_CALL Interrupt
0x6C IC_ENABLE — IIC Enable
0x70 IC_STATUS — IIC Status
0x74 IC_TXFLR — Transmit FIFO Level Register
0x78 IC_RXFLR — Receive FIFO Level Register
0x7C IC_SDA_HOLD — SDA Hold Time Length Reg
0x80 IC_TX_ABRT_SOURCE — IIC Transmit Abort Status Reg
0x84 IC_SLV_DATA_NACK_ONLY — Generate SLV_DATA_NACK Register
0x88 IC_DMA_CR — DMA Control Register
0x8C IC_DMA_TDLR — DMA Transmit Data Level
0x90 IC_DMA_RDLR — DMA Receive Data Level
0x94 IC_SDA_SETUP — SDA Setup Register
0x98 IC_ACK_GENERAL_CALL — ACK General Call Register
0x9C IC_ENABLE_STATUS — Enable Status Register
0xA0 IC_FS_SPKLEN — SS and FS spike suppression limit
0xA4 IC_HS_SPKLEN — HS spike suppression limit
0xA8 IC_CLR_RESTART_DET — Clear RESTART_DET Interrup
0xAC IC_SCL_STUCK_AT_LOW_TIMEOUT — I2C SCL Stuck at Low Timeout
0xB0 IC_SDA_STUCK_AT_LOW_TIMEOUT — I2C SDA Stuck at Low Timeout
0xB4 IC_CLR_SCL_STUCK_DET — Clear SCL Stuck at Low Detect Interrupt
0xF4 IC_COMP_PARAM_1 — Component Parameter Register
0xF8 IC_COMP_VERSION — Component Version ID Register
0xFC IC_COMP_TYPE — Component Type Register

## ADCC_LV
Base 0x5200C800
Same registers: ADCC_LV_NS 0x4200C800, ADCC_HV_NS 0x46005800, ADCC_HV 0x56005800
0x00 REG_ADCC_EN — ADCC module enable
0x04 REG_ADCC_SINGLE — Single shot mode control enable
0x08 REG_ADCC_CH_MASK — input channel mask
0x0C REG_ADCC_SR — channel 0~3 sample rate
0x10 REG_ADCC_DATA_TYPE — data type select (bypass/average)
{0x14+4i} REG_ADCC_CH{i}_OFFSET (i=0..3) — CH{i} offset(signed)
{0x24+4i} REG_ADCC_CH{i}_TH_H (i=0..3) — CH{i} Window High in/out interrupt threshold
{0x34+4i} REG_ADCC_CH{i}_TH_L (i=0..3) — CH{i} Window Low in/out interrupt threshold
0x44 REG_ADCC_INT_DELAY — Interrupt disable time setting
0x48 REG_ADCC_INT_MASK — interrupt mask
0x4C REG_ADCC_INT_CLR — ADCC interrupt clear flag
0x50 REG_ADCC_DBG_SEL — Debug signal select
{0x54+4i} REG_ADCC_CH{i}_GETDATA (i=0..3) — CH{i} Sample data output
0x64 REG_ADCC_GETDATA_SEL — Sample data output select (0: Data Mux / 1: Data Offset)
0x68 REG_ADCC_INT_STATUS — Channel 0~3 interrupt saving
