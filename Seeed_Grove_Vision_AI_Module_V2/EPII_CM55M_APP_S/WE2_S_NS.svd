# WE2_S_NS register map
Vendor: ARM Ltd.; Series: ARMv8.1-M Mainline; File version: 1.0
CPU: CM55 r1p1, little endian, MPU, FPU, double-precision FPU, DSP, VTOR, 3 interrupt priority bits
Registers are 32-bit, read-write, reset 0x0 unless marked. A register's access mark holds for its fields unless they carry their own. Offsets are from the block's base; [hi:lo] are bit positions; {n}, {i} and the like mark numbered series.

## I3C_SLV_0
Base 0x5400D000
Same registers: I3C_SLV_1_NS 0x42002000, I3C_SLV_0_NS 0x4400D000, I3C_SLV_1 0x52002000
0x00 sdr_fifo
{0x4+4i} apb_rw_csrs{i} (i=0..3)
{0x14+4i} apb_ro_csrs{i} (i=0..3)
0x24 gpi_csrs
0x28 gpo_csrs
0x2C ctrl_reg
0x30 ddr_tx_fifo
0x34 ddr_rx_fifo
0x38 sts0_reg
0x3C sts1_reg
0x40 int_sts_reg
0x44 int_mask_reg
0x48 ibi_pl_reg
0x800 pid_instance_id
0x808 bus_idle_timer_reg
0x80C static_addr_reg

## INP
Base 0x55004100
Same registers: INP_HSC_NS 0x43100100, INP_NS 0x45004100, INP_HSC 0x53100100
0x00 inp_en
0x04 io_depth_msbyte_msbit
0x08 reverse_hvsyncchange_inv
0x0C fs_regen_en
0x10 inp_subsample
0x14 inp_vsyncpulse_len
0x18 inp_vsyncDELEFEdelay
0x1C inp_s2perrint
0x20 inp_vsynccnt
0x24 inp_hsynccnt
0x28 inp_out_decnt
0x2C inp_out_le_cnt
0x30 inp_rx_dbg_cnt_for_dly_iobit
0x34 inp_rx_dbg_03to00_dly_iobit
0x38 inp_rx_dbg_07to04_dly_iobit
0x3C inp_rx_dbg_11to08_dly_iobit
0x40 inp_s2p_error_int_mask
0x50 inp_crop_en
0x54 inp_crop_start_xy
0x58 inp_crop_last_xy
0x60 inp_rx_crop_en
0x64 inp_rx_crop_start_xy
0x68 inp_rx_crop_last_xy
0x70 inp_rx_lbuf_en
0x74 inp_rx_lbuf_insert_h_fporch

## INP1BIT
Base 0x55005D00
Same registers: INP1BIT_LSC_NS 0x4200ED00, INP1BIT_NS 0x45005D00, INP1BIT_LSC 0x5200ED00
0x00 enable
0x04 FS_FD_FE_order_sel
0x08 tg2utg
0x0C blank_timeout_th
0x10 error_status2int_en
0x14 error_status_out
0x18 CS_out
0x1C VHsize
0x20 FS_byte_0_3
0x24 FS_byte_4_7
0x28 FS_byte_8_11
0x2C FS_byte_12_15
0x30 CRC16_sensor_hw
0x34 error_clear
0x38 hw_hvsize
0x3C fs_fe_cycle
0x40 rx_dbg_cnt
0x44 rx_dbg_31to00_dly_bit
0x48 rx_dbg_63to32_dly_bit
0x4C rx_dbg_95to64_dly_bit
0x50 fs_cycle_error_cnt_th
0x54 fs_cycle_error_cnt
0x58 VHsize_sw

## INPOV
Base 0x55005B00
Same registers: INPOV_LSC_NS 0x4200EB00, INPOV_NS 0x45005B00, INPOV_LSC 0x5200EB00
0x00 enable
0x04 LSB_first_SOI_EN
0x08 SW_HSIZE_VSIZE
0x0C STS2INT_EN
0x10 OP_SETTING
0x14 SYNC_PRE1BYTE_ZERO_CHK_BITMASK
0x18 FSM_SETTING
0x1C DBG_REC4BYTE_EN
0x30 hwpara_SOF1
0x34 hwpara_SOF2

## JPEG
Base 0x55004800
Same registers: JPEG_HSC_NS 0x43100800, JPEG_NS 0x45004800, JPEG_HSC 0x53100800
0x00 IP_VERSION
0x04 VER_Date
0x08 OP_MODE_HBack
0x0C ENC_WIDTH_Height
0x10 ENC_SAMPLE_Qtable
0x14 DEC_ROI_POSX_POSY
0x18 DEC_ROI_WIDTH_Height
0x1C DEC_WIDTH_Height
0x20 DEC_SAMPLE_Qtable
0x24 ENC_FILESIZE

## MB
Base 0x5400A000
Same registers: MB_NS 0x4400A000
0x00 irq0status
0x04 irq0set
0x08 irq0clear
0x10 irq1status
0x14 irq1set
0x18 irq1clear
{0x100+4i} infodata{i} (i=0..23)
{0x200+4i} mutex{i} (i=0..23)

## mpc_sram0
Base 0x530C0000
Same registers: mpc_ospi_NS 0x43010000, mpc_sram0_NS 0x430C0000, mpc_sram1_NS 0x430D0000, mpc_qspicache_NS 0x430E0000, mpc_sram2_NS 0x4400C000, mpc_ospi 0x53010000, mpc_sram1 0x530D0000, mpc_qspicache 0x530E0000, mpc_sram2 0x5400C000
0x00 CTRL — Control register
0x10 BLK_MAX — Block index maximum value
0x14 BLK_CFG — Block LUT configuration status register
0x18 BLK_IDX — Block LUT index register
0x1C BLK_LUT — Block LUT register
0x20 IRQ_STAT — Interrupt status register
0x24 IRQ_CLEAR — Interrupt clear register
0x28 IRQ_EN — Interrupt signal enable
0x2C IRQ_INFO1 — Interrupt information register 1
0x30 IRQ_INFO2 — Interrupt information register 2
0x34 IRQ_SET — Interrupt set register

## PDM0 — HIMAX PDM
Base 0x5400F000
Same registers: PDM1_NS 0x44005000, PDM0_NS 0x4400F000, PDM1 0x54005000
0x00 PDM_EN
0x04 PDM_REN
0x0C PDM_CER
0x14 PDM_RXFFR
{0x28+0x40*i} PDM_RER{i} (i=0..3)
0x38 PDM_ISR
0x3C PDM_IMR
0x40 PDM_ROR
0x48 PDM_RFCR
0x1C0 PDM_RXDMA
0x1D0 PDM_RR
0x1D4 PDM_CIC_N
0x1D8 PDM_CIC_D
0x1DC PDM_DCRC
{0x1E0+4i} PDM_BRC_B{i} (i=0..3)
0x1F0 PDM_BRC_CLP
0x200 PDM_VAD_CFG
